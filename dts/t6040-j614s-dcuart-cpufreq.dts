// SPDX-License-Identifier: GPL-2.0+ OR MIT
/*
 * J614s DockChannel console + cluster cpufreq (tickets 035/006).
 * Payload lives in t6040-cpufreq.dtsi so the wifi stack can include it too.
 */
/dts-v1/;

#include "t6040-j614s-dcuart.dts"
#include "t6040-cpufreq.dtsi"
