// SPDX-License-Identifier: GPL-2.0+ OR MIT
/* Cumulative first-probe isolation: ASC mailbox plus SART, no NVMe. */

#include "t6040-j614s-dcuart.dts"

/ {
	model = "Apple MacBook Pro (M4 Pro) J614s [GATED ANS SART probe]";
};

&ans_mbox {
	status = "okay";
};

&ans_sart {
	status = "okay";
};
