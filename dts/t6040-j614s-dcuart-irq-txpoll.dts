// SPDX-License-Identifier: GPL-2.0+ OR MIT
/*
 * DockChannel-UART RX IRQ diagnostic with independent TX completion.
 *
 * RX remains interrupt-driven on measured AIC input 816 with BIT(1). TX uses the
 * known FIFO path but polls only for completion, so the diagnostic can report
 * evidence even if the RX storm guard disables the shared AIC line.
 */
#include "t6040-j614s-dcuart-irq.dts"

/ {
	model = "Apple MacBook Pro (M4 Pro) J614s [DockChannel RX IRQ + TX poll diagnostic]";
};

&dockchannel_uart {
	apple,tx-poll-mode;
	apple,irq-telemetry;
	apple,irq-rx-cap = <1000>;
	apple,irq-storm-limit = <1024>;
};
